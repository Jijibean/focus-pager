## firmware/main/Kconfig.projbuild
```kconfig
menu "Focus Pager"

config PAGER_SIMULATOR
    bool "Simulator build (disables Bluetooth for Wokwi)"
    default n
    help
        When enabled, all Bluetooth initialisation (BT controller,
        Bluedroid, ANCS, HFP, brick service) is skipped so the
        firmware can run in the Wokwi simulator without panicking.
        Only the display, encoder, and NVS store are active.

endmenu
```

## firmware/sdkconfig.defaults
```kconfig
#
# sdkconfig.defaults — Focus Pager Phase 1
# Applied on top of ESP-IDF defaults when you run: idf.py set-target esp32
#
# To regenerate sdkconfig from these defaults:  idf.py set-target esp32
# To open menuconfig:                           idf.py menuconfig
#

# ── Bluetooth ────────────────────────────────────────────────────────────────
# Phase 4: BTDM — BLE (ANCS + Brick Control) + Classic BT (HFP calls).
CONFIG_BT_ENABLED=y
CONFIG_BT_BLUEDROID_ENABLED=y
CONFIG_BT_BLE_ENABLED=y
CONFIG_BT_CLASSIC_ENABLED=y

# HFP Hands-Free (ESP32 = HF device, iPhone = AG)
CONFIG_BT_HFP_ENABLE=y
CONFIG_BT_HFP_CLIENT_ENABLE=y
# Route PCM audio through HCI callbacks → we feed it to I2S ourselves
CONFIG_BT_HFP_AUDIO_DATA_PATH_HCI=y

# BT controller must run in BTDM (dual) mode to support both BLE and Classic BT
CONFIG_BTDM_CTRL_MODE_BTDM=y

# GATT client (we discover ANCS on the iPhone)
CONFIG_BT_GATTC_ENABLE=y

# Security / bonding (iOS requires bonding for ANCS)
CONFIG_BT_BLE_SMP_ENABLE=y
CONFIG_BT_SMP_ENABLE=y

# Increase GATT table size for ANCS characteristics
CONFIG_BT_GATT_MAX_SR_PROFILES=8
CONFIG_BT_GATT_MAX_SR_ATTRIBUTES=64

# ── Flash / NVS ──────────────────────────────────────────────────────────────
CONFIG_NVS_ENCRYPTION=n

# ── Flash ─────────────────────────────────────────────────────────────────────
# ESP32 WROOM has 4MB flash
CONFIG_ESPTOOLPY_FLASHSIZE_4MB=y

# ── Partition table ───────────────────────────────────────────────────────────
# Custom 3MB app partition — needed to fit BT + HFP + LVGL Montserrat fonts.
CONFIG_PARTITION_TABLE_CUSTOM=y
CONFIG_PARTITION_TABLE_CUSTOM_FILENAME="partitions.csv"

# ── Logging ──────────────────────────────────────────────────────────────────
# Set to INFO for production; DEBUG shows raw GATT bytes.
CONFIG_LOG_DEFAULT_LEVEL_INFO=y
CONFIG_LOG_MAXIMUM_LEVEL_DEBUG=y

# ── FreeRTOS ─────────────────────────────────────────────────────────────────
CONFIG_FREERTOS_HZ=1000

# ── Serial ───────────────────────────────────────────────────────────────────
# 921600 baud so UART output keeps up with BT log volume
CONFIG_ESP_CONSOLE_UART_BAUDRATE=921600

# ── LVGL ─────────────────────────────────────────────────────────────────────
# Use system malloc (IDF heap) instead of LVGL's 64KB static pool in BSS
CONFIG_LV_USE_CLIB_MALLOC=y

# Montserrat font sizes used in ui.c
CONFIG_LV_FONT_MONTSERRAT_12=y
CONFIG_LV_FONT_MONTSERRAT_14=y
CONFIG_LV_FONT_MONTSERRAT_16=y
CONFIG_LV_FONT_MONTSERRAT_24=y
CONFIG_LV_FONT_MONTSERRAT_32=y
CONFIG_LV_FONT_MONTSERRAT_48=y
```
